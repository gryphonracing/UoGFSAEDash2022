VERSION ""

NS_ :

BS_:

BU_: BMS Third_Party_Device

BO_ 192 MSGID_0XC0: 3 BMS
 SG_ Pack_Open_Voltage : 7|16@0+ (0.1,0) [0|0] "Volts"  Third_Party_Device
 SG_ Pack_SOC : 23|8@0+ (0.5,0) [0|0] "Percent"  Third_Party_Device

BO_ 193 MSGID_0XC1: 4 BMS
 SG_ Pack_Inst_Voltage : 7|16@0+ (0.1,0) [0|0] "Volts"  Third_Party_Device
 SG_ Pack_Current : 23|16@0+ (0.1,0) [0|0] "Amps"  Third_Party_Device

BO_ 194 MSGID_0XC2: 2 BMS
 SG_ High_Temperature : 7|8@0+ (1.0,0) [0|0] "Celsius"  Third_Party_Device
 SG_ Internal_Temperature : 15|8@0+ (1.0,0) [0|0] "Celsius"  Third_Party_Device

CM_ BO_ 192 "This ID Transmits at 1000 ms.";
CM_ BO_ 193 "This ID Transmits at 248 ms.";
CM_ BO_ 194 "This ID Transmits at 1000 ms.";
